## security/ipe/Kconfig
```kconfig
# SPDX-License-Identifier: GPL-2.0-only
#
# Integrity Policy Enforcement (IPE) configuration
#

menuconfig SECURITY_IPE
	bool "Integrity Policy Enforcement (IPE)"
	depends on SECURITY && AUDIT && BLOCK
	select SYSTEM_DATA_VERIFICATION
	select SECURITYFS
	select CRYPTO_SHA1
	help
	  This option enables the Integrity Policy Enforcement subsystem
	  allowing systems to enforce integrity having no dependencies
	  on filesystem metadata, making its decisions based off of kernel-
	  resident features and data structures. A key feature of IPE is a
	  customizable policy to allow admins to reconfigure integrity
	  requirements on the fly.

	  If unsure, answer N.

if SECURITY_IPE

config SECURITY_IPE_BOOT_POLICY
	string "Integrity policy to apply on system startup"
	help
	  This option specifies a filepath to a IPE policy that is compiled
	  into the kernel. This policy will be enforced until a policy update
	  is deployed via the $securityfs/ipe/policies/$policy_name/active
	  interface.

	  If unsure, leave blank.

config SECURITY_IPE_PERMISSIVE_SWITCH
	bool "Enable the ability to switch IPE to permissive mode"
	default y
	help
	  This option enables two ways of switching IPE to permissive mode,
	  a securityfs node, `$securityfs/ipe/enforce`, or a kernel command line
	  parameter, `ipe.enforce`. If either of these is set to 0, files
	  will be subject to IPE's policy, audit messages will be logged, but
	  the policy will not be enforced.

	  If unsure, answer Y.

source "security/ipe/properties/Kconfig"

endif
```

## security/ipe/properties/Kconfig
```kconfig
# SPDX-License-Identifier: GPL-2.0-only
#
# Integrity Policy Enforcement (IPE) configuration
#

config IPE_BOOT_PROP
	bool "Enable trust for boot volume"
	help
	  This option enables the property "boot_verified" in IPE policy.
	  This property 'pins' the initial superblock when something is
	  evaluated as an execution. This property will evaluate to true
	  when the file being evaluated originates from the initial
	  superblock.

	  if unsure, answer N.

config IPE_DM_VERITY_ROOTHASH
	bool "Enable property for authorizing dm-verity volumes via root-hash"
	depends on DM_VERITY
	help
	  This option enables IPE's integration with Device-Mapper Verity.
	  This enables the usage of the property "dmverity_roothash" in IPE's
	  policy. This property allows authorization or revocation via a
	  a hex-string representing the roothash of a dmverity volume.

	  if unsure, answer Y.

config IPE_DM_VERITY_SIGNATURE
	bool "Enable property for verified dm-verity volumes"
	depends on DM_VERITY_VERIFY_ROOTHASH_SIG
	help
	  This option enables IPE's integration with Device-Mapper Verity's
	  signed root-hashes. This enables the usage of the property,
	  "dmverity_signature" in IPE's policy.

	  if unsure, answer Y.

config IPE_INTENDED_PATHNAME
	bool "Enable property for comparison to the application provided path"
	help
	  This option enables IPE's "intended_pathname" property. This is the
	  original userland, application-provided pathname passed to any open
	  system call. This can be used by the userland application to signal
	  its purpose to enforce integrity requirements on paths, such as
	  verifying all config files in /etc.

	  WARNING: intended_pathname is not a security property and should
	  only be used for an application to signal it's intent

	  if unsure, answer Y.
```
